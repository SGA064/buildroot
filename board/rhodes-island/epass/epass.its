## board/rhodes-island/epass/epass.its
```
// SPDX-License-Identifier: GPL-2.0+

/dts-v1/;

/ {
	description = "Linux FIT image for Rhodes Island ePass";
	#address-cells = <1>;

	images {
		kernel {
			description = "ARM zImage";
			data = /incbin/("./zImage");
			type = "kernel";
			arch = "arm";
			os = "linux";
			compression = "none";
			load = <0x80008000>;
			entry = <0x80008000>;
			hash {
				algo = "crc32";
			};
		};

		fdt-epass {
			description = "Rhodes Island ePass device tree";
			data = /incbin/("./suniv-f1c200s-epass.dtb");
			type = "flat_dt";
			arch = "arm";
			compression = "none";
			hash {
				algo = "crc32";
			};
		};
	};

	configurations {
		default = "conf-epass";

		conf-epass {
			description = "Rhodes Island ePass";
			kernel = "kernel";
			fdt = "fdt-epass";
		};
	};
};
```

## configs/epass_f1c200s_defconfig
```kconfig
BR2_arm=y
BR2_TOOLCHAIN_BUILDROOT_MUSL=y
BR2_PACKAGE_HOST_LINUX_HEADERS_CUSTOM_6_18=y
BR2_TARGET_GENERIC_HOSTNAME="ePass"
BR2_TARGET_GENERIC_ISSUE="Welcome to Buildroot for the Rhodes Island ePass"
BR2_TARGET_GENERIC_GETTY_PORT="ttyS0"
BR2_TARGET_GENERIC_GETTY_BAUDRATE_115200=y
BR2_ROOTFS_OVERLAY="board/rhodes-island/epass/rootfs-overlay"
BR2_ROOTFS_POST_BUILD_SCRIPT="board/rhodes-island/epass/post-build.sh"
BR2_ROOTFS_POST_IMAGE_SCRIPT="board/rhodes-island/epass/post-image.sh"
BR2_LINUX_KERNEL=y
BR2_LINUX_KERNEL_CUSTOM_GIT=y
BR2_LINUX_KERNEL_CUSTOM_REPO_URL="https://github.com/SGA064/linux-6.18.8.git"
BR2_LINUX_KERNEL_CUSTOM_REPO_VERSION="main"
BR2_LINUX_KERNEL_DEFCONFIG="epass_f1c200s"
BR2_LINUX_KERNEL_LZ4=y
BR2_LINUX_KERNEL_DTS_SUPPORT=y
BR2_LINUX_KERNEL_INTREE_DTS_NAME="allwinner/suniv-f1c200s-epass"
BR2_LINUX_KERNEL_NEEDS_HOST_OPENSSL=y
BR2_PACKAGE_BUSYBOX_SHOW_OTHERS=y
BR2_PACKAGE_ALSA_UTILS=y
# BR2_PACKAGE_ALSA_UTILS_ALSACTL is not set
# BR2_PACKAGE_ALSA_UTILS_ALSAMIXER is not set
BR2_PACKAGE_ALSA_UTILS_AMIXER=y
BR2_PACKAGE_ALSA_UTILS_APLAY=y
# BR2_PACKAGE_FFMPEG_FFMPEG is not set
BR2_PACKAGE_FFMPEG_ENCODERS=""
BR2_PACKAGE_FFMPEG_DECODERS="aac aac_fixed"
BR2_PACKAGE_FFMPEG_MUXERS=""
BR2_PACKAGE_FFMPEG_DEMUXERS=""
BR2_PACKAGE_FFMPEG_PARSERS=""
BR2_PACKAGE_FFMPEG_BSFS=""
BR2_PACKAGE_FFMPEG_PROTOCOLS=""
BR2_PACKAGE_FFMPEG_FILTERS=""
# BR2_PACKAGE_FFMPEG_INDEVS is not set
# BR2_PACKAGE_FFMPEG_OUTDEVS is not set
BR2_PACKAGE_FFMPEG_EXTRACONF="--disable-programs --disable-avdevice --disable-network --disable-avformat"
BR2_PACKAGE_FPLAYERDEMO=y
BR2_PACKAGE_LIBDRM_INSTALL_TESTS=y
BR2_PACKAGE_MTD=y
# BR2_PACKAGE_MTD_FLASHCP is not set
# BR2_PACKAGE_MTD_FLASH_ERASE is not set
# BR2_PACKAGE_MTD_FLASH_LOCK is not set
# BR2_PACKAGE_MTD_FLASH_UNLOCK is not set
# BR2_PACKAGE_MTD_MTD_DEBUG is not set
BR2_PACKAGE_MTD_MTDPART=y
# BR2_PACKAGE_MTD_NANDDUMP is not set
# BR2_PACKAGE_MTD_NANDTEST is not set
# BR2_PACKAGE_MTD_NANDWRITE is not set
BR2_PACKAGE_I2C_TOOLS=y
BR2_PACKAGE_UMTPRD=y
BR2_PACKAGE_WS73_RADIO=y
BR2_PACKAGE_ALSA_LIB_PCM_PLUGINS=""
BR2_PACKAGE_ALSA_LIB_CTL_PLUGINS=""
# BR2_PACKAGE_ALSA_LIB_ALOAD is not set
# BR2_PACKAGE_ALSA_LIB_RAWMIDI is not set
# BR2_PACKAGE_ALSA_LIB_HWDEP is not set
# BR2_PACKAGE_ALSA_LIB_SEQ is not set
# BR2_PACKAGE_ALSA_LIB_UCM is not set
# BR2_PACKAGE_ALSA_LIB_OLD_SYMBOLS is not set
# BR2_PACKAGE_ALSA_LIB_TOPOLOGY is not set
BR2_PACKAGE_LIBGPIOD=y
BR2_PACKAGE_LIBGPIOD_TOOLS=y
BR2_PACKAGE_BLUEZ5_UTILS=y
BR2_PACKAGE_BLUEZ5_UTILS_CLIENT=y
BR2_PACKAGE_DROPBEAR=y
BR2_PACKAGE_DROPBEAR_DISABLE_REVERSEDNS=y
BR2_PACKAGE_IW=y
BR2_PACKAGE_WIRELESS_TOOLS=y
BR2_PACKAGE_WPA_SUPPLICANT=y
BR2_PACKAGE_WPA_SUPPLICANT_WEXT=y
BR2_PACKAGE_WPA_SUPPLICANT_CLI=y
BR2_PACKAGE_WPA_SUPPLICANT_PASSPHRASE=y
BR2_TARGET_ROOTFS_UBI=y
BR2_TARGET_ROOTFS_UBI_SUBSIZE=0
BR2_TARGET_ROOTFS_UBIFS_LEBSIZE=0x1f000
BR2_TARGET_ROOTFS_UBIFS_MAXLEBCNT=947
BR2_TARGET_UBOOT=y
BR2_TARGET_UBOOT_BUILD_SYSTEM_KCONFIG=y
BR2_TARGET_UBOOT_CUSTOM_GIT=y
BR2_TARGET_UBOOT_CUSTOM_REPO_URL="https://github.com/SGA064/u-boot.git"
BR2_TARGET_UBOOT_CUSTOM_REPO_VERSION="main"
BR2_TARGET_UBOOT_BOARD_DEFCONFIG="epass_f1c200s"
BR2_TARGET_UBOOT_NEEDS_DTC=y
BR2_TARGET_UBOOT_NEEDS_PYLIBFDT=y
BR2_TARGET_UBOOT_NEEDS_OPENSSL=y
BR2_TARGET_UBOOT_SPL=y
BR2_TARGET_UBOOT_SPL_NAME="u-boot-sunxi-with-spl.bin"
BR2_PACKAGE_HOST_UBOOT_TOOLS=y
BR2_PACKAGE_HOST_UBOOT_TOOLS_FIT_SUPPORT=y
```

## package/epass-otactl/Config.in
```kconfig
config BR2_PACKAGE_EPASS_OTACTL
	bool "epass-otactl"
	depends on BR2_USE_MMU
	select BR2_PACKAGE_MTD
	help
	  Manage the rotating raw-MTD boot control records used by the
	  Rhodes Island ePass U-Boot recovery update scheme.
```

## package/fplayerdemo/Config.in
```kconfig
config BR2_PACKAGE_FPLAYERDEMO
	bool "fplayerdemo"
	depends on BR2_TOOLCHAIN_HAS_THREADS # alsa-lib, ffmpeg, libdrm
	depends on BR2_PACKAGE_FFMPEG_ARCH_SUPPORTS
	select BR2_PACKAGE_ALSA_LIB
	select BR2_PACKAGE_ALSA_LIB_PCM
	select BR2_PACKAGE_FFMPEG
	select BR2_PACKAGE_LIBDRM
	help
	  F1C200S Cedrus/KMS player and diagnostics demo.

	  It uses a built-in MP4/H.264 parser, the V4L2 stateless
	  request API for Cedrus decode, KMS/DRM for display,
	  FFmpeg/libavcodec for AAC decoding, and ALSA for audio output.

comment "fplayerdemo needs a toolchain w/ threads"
	depends on !BR2_TOOLCHAIN_HAS_THREADS

comment "fplayerdemo needs FFmpeg support on this architecture"
	depends on BR2_TOOLCHAIN_HAS_THREADS
	depends on !BR2_PACKAGE_FFMPEG_ARCH_SUPPORTS
```

## package/ws73-radio/Config.in
```kconfig
config BR2_PACKAGE_WS73_RADIO
	bool "WS73/Hi3873S SDIO radio"
	depends on BR2_LINUX_KERNEL
	select BR2_LINUX_NEEDS_MODULES # not using kernel-module infra
	help
	  Build and install the Ai-WS1-CBS WS73/Hi3873S SDIO Wi-Fi,
	  Bluetooth HCI, and SparkLink transport modules, device
	  firmware, runtime INI, and the ws73-switch helper.

	  The vendor SDK must be available next to the Buildroot tree as
	  Ai-WS1-CBS-CBE_Linux.

comment "WS73/Hi3873S SDIO radio needs a Linux kernel to be built"
	depends on !BR2_LINUX_KERNEL
```
